## conf/distro/custom-distro.conf
```bitbake
DISTRO_NAME = "Custom Linux Distro"
DISTRO_VERSION = "1.0"

DISTRO = "custom-distro"

VIRTUAL-RUNTIME_init_manager = "systemd"
VIRTUAL-RUNTIME_initscripts = ""

DISTRO_FEATURES = "systemd usrmerge"

PACKAGE_CLASSES = "package_ipk"

EXTRA_IMAGE_FEATURES = "debug-tweaks ssh-server-openssh"

DISTRO_FEATURES_BACKFILL_CONSIDERED = "sysvinit"

require conf/distro/include/custom-distro.inc
```

## conf/layer.conf
```bitbake
BBPATH .= ":${LAYERDIR}"
BBFILES += "${LAYERDIR}/recipes-*/*/*.bb ${LAYERDIR}/recipes-*/*/*.bbappend"

BBFILE_COLLECTIONS += "meta-layer"
BBFILE_PATTERN_meta-layer := "^${LAYERDIR}/"
BBFILE_PRIORITY_meta-layer = "1"

LAYERVERSION_meta-layer = "1"
LAYERDEPENDS_meta-layer = "core"
LAYERSERIES_COMPAT_meta-layer = "scarthgap"
```
